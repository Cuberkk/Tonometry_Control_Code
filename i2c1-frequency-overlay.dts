/dts-v1/;
/plugin/;

/ {
    compatible = "brcm,bcm2712", "brcm,bcm2711", "brcm,bcm2835";

    /* Bus 1 on the 40-pin header is typically &i2c1 */
    fragment@0 {
        target = <&i2c1>;
        __overlay__ {
            /* Set to 400000 for 400 kHz, or 1000000 for 1 MHz (Fast-mode Plus) */
            clock-frequency = <400000>;
        };
    };
};
